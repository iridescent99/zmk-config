## boards/shields/sharp_mip/Kconfig.defconfig
```kconfig
# Copyright (c) 2023 The ZMK Contributors
# SPDX-License-Identifier: MIT

if SHIELD_SHARP_MIP

config LV_Z_VDB_SIZE
    default 100

config LV_DPI_DEF
    default 161

config LV_Z_BITS_PER_PIXEL
    default 1

choice LV_COLOR_DEPTH
    default LV_COLOR_DEPTH_1
endchoice

choice ZMK_DISPLAY_WORK_QUEUE
    default ZMK_DISPLAY_WORK_QUEUE_DEDICATED
endchoice

choice ZMK_DISPLAY_STATUS_SCREEN
    default ZMK_DISPLAY_STATUS_SCREEN_CUSTOM
endchoice

config LV_Z_MEM_POOL_SIZE
    default 4096 if ZMK_DISPLAY_STATUS_SCREEN_CUSTOM

config ZMK_DISPLAY_STATUS_SCREEN_CUSTOM
    imply SHARP_MIP_WIDGET_STATUS

config SHARP_MIP_WIDGET_STATUS
    bool "Custom Sharp MIP status widget"
    select LV_FONT_MONTSERRAT_16
    select LV_USE_IMG
    select LV_USE_CANVAS

config SHARP_MIP_WIDGET_INVERTED
    bool "Invert Sharp MIP status widget colors"

config SHARP_MIP_ROTATE_180
    bool "Rotate Sharp MIP display 180 degrees"

config SOFLE_LILAC_LIGHTING
    bool "Start both Sofle halves with solid lilac lighting"
    depends on (BOARD_SOFLE_CHOC_PRO_LEFT || BOARD_SOFLE_CHOC_PRO_RIGHT)
    depends on ZMK_RGB_UNDERGLOW && ZMK_RGB_UNDERGLOW_EXT_POWER && SETTINGS
    help
        Apply solid lilac and enable LED power after saved settings load. This
        overrides a saved RGB-off state at boot; normal lighting controls and
        idle power saving still work. Only RGB/power preferences are updated.
        Bluetooth bonds, Studio mappings and the keymap are never touched.

config SOFLE_SPLIT_DIAGNOSTICS
    bool "Temporary read-only Sofle right split diagnostics"
    depends on BOARD_SOFLE_CHOC_PRO_RIGHT && ZMK_SPLIT_BLE && !ZMK_SPLIT_ROLE_CENTRAL
    depends on ZMK_DISPLAY && SHARP_MIP_WIDGET_STATUS && ZMK_DISPLAY_WORK_QUEUE_DEDICATED
    select LV_FONT_UNSCII_8
    help
        Show local scan activity, BLE security and key notification subscription
        in the right status area. No key identity, history, logging, persistent
        writes, bond changes or transport changes. Disable after diagnosis.

config SOFLE_SPLIT_REPAIR
    bool "One-time Sofle split-bond repair (preserve host profiles)"
    depends on (BOARD_SOFLE_CHOC_PRO_LEFT || BOARD_SOFLE_CHOC_PRO_RIGHT)
    depends on ZMK_SPLIT_BLE && BT_SETTINGS && SETTINGS_NVS
    help
        Explicit recovery image only. Before ZMK loads Bluetooth settings, remove
        the known split peer's key/CCC/client-feature/service-changed records once.
        Refuse ambiguous peers or host-profile overlaps. Preserve local Bluetooth
        identity, host pairings, Studio and other settings. Adds an attempt marker
        so later reboots and reflashes never repeat the deletion automatically.

config MAIN_STACK_SIZE
    default 2048 if SOFLE_SPLIT_REPAIR

if !ZMK_SPLIT || ZMK_SPLIT_ROLE_CENTRAL

config SOFLE_KEYPRESS_DISPLAY
    bool "Show the latest resolved key on the Sofle central display"
    depends on BOARD_SOFLE_CHOC_PRO_LEFT && ZMK_DISPLAY && SHARP_MIP_WIDGET_STATUS
    depends on ZMK_DISPLAY_WORK_QUEUE_DEDICATED
    select LV_FONT_MONTSERRAT_48
    select LV_FONT_MONTSERRAT_26
    help
        Replace the central status widget with a transient key label, held
        modifiers, battery, connection and active layer. No key history is
        stored or transmitted. Disable to restore the original status widget.

config SHARP_MIP_WIDGET_STATUS
    select LV_FONT_MONTSERRAT_18
    select LV_FONT_MONTSERRAT_14
    select LV_FONT_UNSCII_8
    select ZMK_WPM

endif # !ZMK_SPLIT || ZMK_SPLIT_ROLE_CENTRAL

config ZMK_DISPLAY_STATUS_SCREEN_BUILT_IN
    select LV_FONT_MONTSERRAT_26

endif # SHIELD_SHARP_MIP
```

## boards/shields/sofle_gradient/Kconfig.defconfig
```kconfig
# SPDX-License-Identifier: MIT
if SHIELD_SOFLE_GRADIENT
config SOFLE_GRADIENT
    def_bool y
    depends on BOARD_SOFLE_CHOC_PRO_LEFT || BOARD_SOFLE_CHOC_PRO_RIGHT
    depends on ZMK_RGB_UNDERGLOW
config SOFLE_PHYSICAL_GRADIENT
    bool "One lavender-to-pink gradient across both Sofle halves"
    depends on SOFLE_GRADIENT
    help
        Map each LED to physical X using Keebart's provisional Bluetooth-board
        map. Use a fixed lavender/lilac/pink palette; brightness and off controls
        work, hue/saturation are intentionally replaced by this palette.
endif
```

## boards/shields/sofle_gradient/Kconfig.shield
```kconfig
# SPDX-License-Identifier: MIT
config SHIELD_SOFLE_GRADIENT
    def_bool $(shields_list_contains,sofle_gradient)
```

## dts/bindings/led_strip/keebart,sofle-gradient.yaml
```yaml
description: Sofle LED strip hue-gradient filter
compatible: "keebart,sofle-gradient"
include: base.yaml
properties:
  strip:
    type: phandle
    required: true
    description: Existing WS2812 strip to drive
  chain-length:
    type: int
    required: true
    description: Must match the physical strip's LED count
```
